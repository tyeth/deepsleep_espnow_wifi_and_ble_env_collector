## tools/repro_espnow_default_peer/sdkconfig.defaults
```kconfig
CONFIG_IDF_TARGET="esp32c6"
CONFIG_ESPTOOLPY_FLASHSIZE_4MB=y
CONFIG_ESP_CONSOLE_USB_SERIAL_JTAG=y
CONFIG_ESP_CONSOLE_UART_DEFAULT=n
CONFIG_ESP_PHY_CALIBRATION_AND_DATA_STORAGE=n
CONFIG_ESP_WIFI_NVS_ENABLED=n
CONFIG_PARTITION_TABLE_CUSTOM=y
CONFIG_PARTITION_TABLE_CUSTOM_FILENAME="partitions.csv"
```

## tools/repro_p256_premaster/testcase.yaml
```yaml
tests:
  crypto.p256_premaster.p256m:
    platform_allow: native_sim/native/64
    tags: [crypto, mbedtls]
    extra_configs:
      - CONFIG_MBEDTLS_PSA_P256M_DRIVER_ENABLED=y
  crypto.p256_premaster.builtin:
    platform_allow: native_sim/native/64
    tags: [crypto, mbedtls]
    extra_configs:
      - CONFIG_MBEDTLS_PSA_P256M_DRIVER_ENABLED=n
```

## tools/repro_tls_server_policy/testcase.yaml
```yaml
tests:
  crypto.circuitpython_tls_server_policy:
    platform_allow: native_sim/native/64
    tags: [crypto, mbedtls]
```
