## CMakeLists.txt
```
cmake_minimum_required(VERSION 3.20.0)
find_package(Zephyr REQUIRED HINTS $ENV{ZEPHYR_BASE})
project(circuitpython_tls_server_policy)
target_sources(app PRIVATE src/main.c)
```

## prj.conf
```kconfig
CONFIG_ZTEST=y
CONFIG_ZTEST_STACK_SIZE=16384
CONFIG_ENTROPY_GENERATOR=y
CONFIG_PSA_CRYPTO=y
CONFIG_PSA_CRYPTO_PROVIDER_MBEDTLS=y
CONFIG_MBEDTLS=y
CONFIG_MBEDTLS_PK_WRITE_C=y
CONFIG_MBEDTLS_PK_PARSE_C=y
CONFIG_MBEDTLS_PEM_PARSE_C=y
CONFIG_MBEDTLS_X509_CRT_PARSE_C=y
CONFIG_MBEDTLS_CIPHERSUITE_TLS_ECDHE_ECDSA_WITH_AES_128_GCM_SHA256=y
CONFIG_MBEDTLS_PSA_P256M_DRIVER_ENABLED=n
CONFIG_PSA_WANT_KEY_TYPE_ECC_KEY_PAIR_IMPORT=y
CONFIG_PSA_WANT_KEY_TYPE_ECC_KEY_PAIR_EXPORT=y
CONFIG_PSA_WANT_KEY_TYPE_ECC_KEY_PAIR_GENERATE=y
CONFIG_PSA_WANT_ECC_SECP_R1_256=y
CONFIG_PSA_WANT_ALG_ECDH=y
CONFIG_PSA_WANT_ALG_ECDSA=y
```

## src/main.c
```c
// SPDX-License-Identifier: MIT
#include <zephyr/ztest.h>
#include <mbedtls/ssl.h>
#include <mbedtls/x509_crt.h>
#include <mbedtls/pk.h>
#include <psa/crypto.h>
#include <string.h>
#include "credentials.h"

typedef struct {
    mbedtls_ssl_context ssl;
    mbedtls_ssl_config conf;
    mbedtls_x509_crt cacert;
    mbedtls_x509_crt cert;
    mbedtls_pk_context key;
} endpoint;
typedef struct {
    int (*crt_bundle_attach)(mbedtls_ssl_config *);
    const unsigned char *cacert_buf;
    size_t cacert_bytes;
} policy_context;
#include "policy.h"

static mbedtls_x509_crt roots;
static int attach_test_roots(mbedtls_ssl_config *conf) {
    mbedtls_ssl_conf_ca_chain(conf, &roots, NULL);
    return 0;
}
typedef struct { unsigned char data[65536]; size_t used; } queue;
typedef struct { queue *in; queue *out; } transport;
static queue c2s, s2c;
static int send_bytes(void *ctx, const unsigned char *data, size_t len) {
    transport *t = ctx;
    if (len > sizeof(t->out->data) - t->out->used) return MBEDTLS_ERR_SSL_WANT_WRITE;
    memcpy(t->out->data + t->out->used, data, len);
    t->out->used += len;
    return (int)len;
}
static int recv_bytes(void *ctx, unsigned char *data, size_t len) {
    transport *t = ctx;
    if (!t->in->used) return MBEDTLS_ERR_SSL_WANT_READ;
    len = MIN(len, t->in->used);
    memcpy(data, t->in->data, len);
    t->in->used -= len;
    memmove(t->in->data, t->in->data + len, t->in->used);
    return (int)len;
}
static void init_endpoint(endpoint *e) {
    memset(e, 0, sizeof(*e));
    mbedtls_ssl_init(&e->ssl);
    mbedtls_ssl_config_init(&e->conf);
    mbedtls_x509_crt_init(&e->cacert);
    mbedtls_x509_crt_init(&e->cert);
    mbedtls_pk_init(&e->key);
}
static void free_endpoint(endpoint *e) {
    mbedtls_ssl_free(&e->ssl);
    mbedtls_ssl_config_free(&e->conf);
    mbedtls_x509_crt_free(&e->cacert);
    mbedtls_x509_crt_free(&e->cert);
    mbedtls_pk_free(&e->key);
}
static void own_cert(endpoint *e, bool trusted) {
    const unsigned char *cert = trusted ? trusted_cert : untrusted_cert;
    const unsigned char *key = trusted ? trusted_key : untrusted_key;
    zassert_equal(mbedtls_x509_crt_parse(&e->cert, cert, strlen((const char *)cert) + 1), 0);
    zassert_equal(mbedtls_pk_parse_key(&e->key, key, strlen((const char *)key) + 1, NULL, 0), 0);
    zassert_equal(mbedtls_ssl_conf_own_cert(&e->conf, &e->cert, &e->key), 0);
}
static bool pending(int ret) {
    return ret == MBEDTLS_ERR_SSL_WANT_READ || ret == MBEDTLS_ERR_SSL_WANT_WRITE;
}
typedef struct { int server; int client; } result;
// CA mode: 0 default bundle, 1 explicit CA, 2 no CA.
static result handshake(bool fixed, int ca_mode, bool client_cert, bool trusted_client,
    bool trusted_server, const char *hostname) {
    endpoint server, client;
    init_endpoint(&server);
    init_endpoint(&client);
    zassert_equal(psa_crypto_init(), PSA_SUCCESS);
    mbedtls_x509_crt_init(&roots);
    zassert_equal(mbedtls_x509_crt_parse(&roots, trusted_cert, sizeof(trusted_cert)), 0);
    policy_context sp = {0}, cp = {.crt_bundle_attach = attach_test_roots};
    if (ca_mode == 0) sp.crt_bundle_attach = attach_test_roots;
    if (ca_mode == 1) { sp.cacert_buf = trusted_cert; sp.cacert_bytes = sizeof(trusted_cert); }
    int (*policy)(policy_context *, endpoint *, bool) = fixed ? policy_fixed : policy_baseline;
    zassert_equal(policy(&sp, &server, true), 0);
    zassert_equal(policy(&cp, &client, false), 0);
    own_cert(&server, trusted_server);
    if (client_cert) own_cert(&client, trusted_client);
    zassert_equal(mbedtls_ssl_setup(&server.ssl, &server.conf), 0);
    zassert_equal(mbedtls_ssl_setup(&client.ssl, &client.conf), 0);
    zassert_equal(mbedtls_ssl_set_hostname(&client.ssl, hostname), 0);
    c2s.used = s2c.used = 0;
    transport st = {.in=&c2s, .out=&s2c}, ct = {.in=&s2c, .out=&c2s};
    mbedtls_ssl_set_bio(&server.ssl, &st, send_bytes, recv_bytes, NULL);
    mbedtls_ssl_set_bio(&client.ssl, &ct, send_bytes, recv_bytes, NULL);
    result r = {MBEDTLS_ERR_SSL_WANT_READ, MBEDTLS_ERR_SSL_WANT_READ};
    for (int i = 0; i < 1000; ++i) {
        if (pending(r.client)) r.client = mbedtls_ssl_handshake(&client.ssl);
        if (pending(r.server)) r.server = mbedtls_ssl_handshake(&server.ssl);
        if ((!r.server && !r.client) || (r.server && !pending(r.server)) || (r.client && !pending(r.client))) break;
    }
    if (!r.server && !r.client) {
        const unsigned char request[] = "GET / HTTP/1.0\r\n\r\n";
        unsigned char received[sizeof(request)] = {0};
        zassert_equal(mbedtls_ssl_write(&client.ssl, request, sizeof(request)), sizeof(request));
        zassert_equal(mbedtls_ssl_read(&server.ssl, received, sizeof(received)), sizeof(request));
        zassert_mem_equal(request, received, sizeof(request));
    }
    printk("POLICY fixed=%d ca_mode=%d client_cert=%d trusted_client=%d trusted_server=%d hostname=%s server=%d client=%d\n", fixed, ca_mode, client_cert, trusted_client, trusted_server, hostname, r.server, r.client);
    free_endpoint(&server);
    free_endpoint(&client);
    mbedtls_x509_crt_free(&roots);
    return r;
}
#define NAME "envhub-test.invalid"
ZTEST(policy, test_baseline_default_demands_client) {
    result r = handshake(false, 0, false, true, true, NAME);
    zassert_equal(r.server, MBEDTLS_ERR_SSL_NO_CLIENT_CERTIFICATE);
}
ZTEST(policy, test_fixed_default_accepts_no_client) {
    result r = handshake(true, 0, false, true, true, NAME);
    zassert_equal(r.server, 0); zassert_equal(r.client, 0);
}
ZTEST(policy, test_explicit_ca_requires_client) {
    for (int fixed=0; fixed<2; ++fixed) {
        result r = handshake(fixed, 1, false, true, true, NAME);
        zassert_equal(r.server, MBEDTLS_ERR_SSL_NO_CLIENT_CERTIFICATE);
    }
}
ZTEST(policy, test_explicit_ca_accepts_trusted_client) {
    for (int fixed=0; fixed<2; ++fixed) {
        result r = handshake(fixed, 1, true, true, true, NAME);
        zassert_equal(r.server, 0); zassert_equal(r.client, 0);
    }
}
ZTEST(policy, test_explicit_ca_rejects_untrusted_client) {
    for (int fixed=0; fixed<2; ++fixed) {
        result r = handshake(fixed, 1, true, false, true, NAME);
        zassert_equal(r.server, MBEDTLS_ERR_X509_CERT_VERIFY_FAILED);
    }
}
ZTEST(policy, test_no_ca_accepts_no_client) {
    for (int fixed=0; fixed<2; ++fixed) {
        result r = handshake(fixed, 2, false, true, true, NAME);
        zassert_equal(r.server, 0); zassert_equal(r.client, 0);
    }
}
ZTEST(policy, test_client_rejects_wrong_hostname) {
    for (int fixed=0; fixed<2; ++fixed) {
        result r = handshake(fixed, 2, false, true, true, "wrong.invalid");
        zassert_equal(r.client, MBEDTLS_ERR_X509_CERT_VERIFY_FAILED);
    }
}
ZTEST(policy, test_client_rejects_untrusted_server) {
    for (int fixed=0; fixed<2; ++fixed) {
        result r = handshake(fixed, 2, false, true, false, NAME);
        zassert_equal(r.client, MBEDTLS_ERR_X509_CERT_VERIFY_FAILED);
    }
}
ZTEST_SUITE(policy, NULL, NULL, NULL, NULL, NULL);
```

## src/credentials.h
```c
// PUBLIC TEST CREDENTIALS ONLY. Never use outside this isolated test.
static const unsigned char trusted_cert[] =
"-----BEGIN CERTIFICATE-----\n"
"MIIB4zCCAYigAwIBAgIUSIaAeXsUe3Qr2YjrOz2tQrQwFxQwCgYIKoZIzj0EAwIw\n"
"HjEcMBoGA1UEAwwTZW52aHViLXRlc3QuaW52YWxpZDAeFw0yNjEwMjIxNzUzMzda\n"
"Fw0zNjEwMTkxNzUzMzdaMB4xHDAaBgNVBAMME2Vudmh1Yi10ZXN0LmludmFsaWQw\n"
"WTATBgcqhkjOPQIBBggqhkjOPQMBBwNCAATmaHs2lQl6qZONiJeYZFm4YSyZjZyZ\n"
"EQFFvauNQvWC0T+ZhcTR9aIeLmG/j6Wy2to+bu5Rk5cuZj4wAvK7ZCAno4GjMIGg\n"
"MB0GA1UdDgQWBBQRBGV5eVS5+13fim83+fJ6k3xkYjAfBgNVHSMEGDAWgBQRBGV5\n"
"eVS5+13fim83+fJ6k3xkYjAeBgNVHREEFzAVghNlbnZodWItdGVzdC5pbnZhbGlk\n"
"MA8GA1UdEwEB/wQFMAMBAf8wDgYDVR0PAQH/BAQDAgKEMB0GA1UdJQQWMBQGCCsG\n"
"AQUFBwMBBggrBgEFBQcDAjAKBggqhkjOPQQDAgNJADBGAiEAjZcrv7EpAjqdTkZk\n"
"b3W67N2n5FkahIaxX7T3GWw8QcECIQCL2HGlJD2gisqjbw4RAAG/09nw18sLQ0Nx\n"
"dVbKJh4d6g==\n"
"-----END CERTIFICATE-----\n";

static const unsigned char trusted_key[] =
"-----BEGIN PRIVATE KEY-----\n"
"MIGHAgEAMBMGByqGSM49AgEGCCqGSM49AwEHBG0wawIBAQQgACsk019sqVlvRZ8I\n"
"3nQNU5Qom4Kw0MasDC4c4XEFfKahRANCAATmaHs2lQl6qZONiJeYZFm4YSyZjZyZ\n"
"EQFFvauNQvWC0T+ZhcTR9aIeLmG/j6Wy2to+bu5Rk5cuZj4wAvK7ZCAn\n"
"-----END PRIVATE KEY-----\n";

static const unsigned char untrusted_cert[] =
"-----BEGIN CERTIFICATE-----\n"
"MIIB4zCCAYigAwIBAgIUbfepRPS2VGTlC4wIZN0bs1+2a9EwCgYIKoZIzj0EAwIw\n"
"HjEcMBoGA1UEAwwTZW52aHViLXRlc3QuaW52YWxpZDAeFw0yNjEwMjIxNzUzMzda\n"
"Fw0zNjEwMTkxNzUzMzdaMB4xHDAaBgNVBAMME2Vudmh1Yi10ZXN0LmludmFsaWQw\n"
"WTATBgcqhkjOPQIBBggqhkjOPQMBBwNCAARAi3SmDL/0zPVweMHFNwSVwA/zNAPS\n"
"kmEePDfBIxvU6mVdRHlmhnAFs6VGu4eEc1v02OoyqDCUk5kdX+Lli7f4o4GjMIGg\n"
"MB0GA1UdDgQWBBQfegRdRc7KlT3k5ZP9G4jJseOcZDAfBgNVHSMEGDAWgBQfegRd\n"
"Rc7KlT3k5ZP9G4jJseOcZDAeBgNVHREEFzAVghNlbnZodWItdGVzdC5pbnZhbGlk\n"
"MA8GA1UdEwEB/wQFMAMBAf8wDgYDVR0PAQH/BAQDAgKEMB0GA1UdJQQWMBQGCCsG\n"
"AQUFBwMBBggrBgEFBQcDAjAKBggqhkjOPQQDAgNJADBGAiEAy4mJYMqiZUDZYvS8\n"
"hb0hRG4Qk5t6xBi3bS1zG9WBqWwCIQDcR4ougQ5e+qnv2l5iWA0G9q4zl0Lq8W9n\n"
"XZae2TX0oQ==\n"
"-----END CERTIFICATE-----\n";

static const unsigned char untrusted_key[] =
"-----BEGIN PRIVATE KEY-----\n"
"MIGHAgEAMBMGByqGSM49AgEGCCqGSM49AwEHBG0wawIBAQQg6oejP+3puXqfrxrq\n"
"TvRty0w1yyvmzwBPI08z/GHJ7T+hRANCAARAi3SmDL/0zPVweMHFNwSVwA/zNAPS\n"
"kmEePDfBIxvU6mVdRHlmhnAFs6VGu4eEc1v02OoyqDCUk5kdX+Lli7f4\n"
"-----END PRIVATE KEY-----\n";
```

## src/policy.h
```c
// Generated from actual CircuitPython source, without rewriting the policy.
static int policy_baseline(policy_context *self, endpoint *o, bool server_side) {
    int ret = mbedtls_ssl_config_defaults(&o->conf,
        server_side ? MBEDTLS_SSL_IS_SERVER : MBEDTLS_SSL_IS_CLIENT,
        MBEDTLS_SSL_TRANSPORT_STREAM,
        MBEDTLS_SSL_PRESET_DEFAULT);
    if (ret != 0) {
        goto cleanup;
    }

    if (self->crt_bundle_attach != NULL) {
        mbedtls_ssl_conf_authmode(&o->conf, MBEDTLS_SSL_VERIFY_REQUIRED);
        self->crt_bundle_attach(&o->conf);
    } else if (self->cacert_buf && self->cacert_bytes) {
        ret = mbedtls_x509_crt_parse(&o->cacert, self->cacert_buf, self->cacert_bytes);
        if (ret != 0) {
            goto cleanup;
        }
        mbedtls_ssl_conf_authmode(&o->conf, MBEDTLS_SSL_VERIFY_REQUIRED);
        mbedtls_ssl_conf_ca_chain(&o->conf, &o->cacert, NULL);

    } else {
        mbedtls_ssl_conf_authmode(&o->conf, MBEDTLS_SSL_VERIFY_NONE);
    }

cleanup:
    return ret;
}

static int policy_fixed(policy_context *self, endpoint *o, bool server_side) {
    int ret = mbedtls_ssl_config_defaults(&o->conf,
        server_side ? MBEDTLS_SSL_IS_SERVER : MBEDTLS_SSL_IS_CLIENT,
        MBEDTLS_SSL_TRANSPORT_STREAM,
        MBEDTLS_SSL_PRESET_DEFAULT);
    if (ret != 0) {
        goto cleanup;
    }

    if (server_side && !(self->cacert_buf && self->cacert_bytes)) {
        // On a server the CA store is about authenticating *clients*. A
        // context that only had load_cert_chain() called on it -- the normal
        // HTTPS-server setup -- must not demand a client certificate, which is
        // what the default root bundle turned into: every handshake failed
        // with MBEDTLS_ERR_SSL_NO_CLIENT_CERTIFICATE. Match CPython, where a
        // server-side context defaults to CERT_NONE; a program that loads its
        // own CA with load_verify_locations() still gets client verification.
        mbedtls_ssl_conf_authmode(&o->conf, MBEDTLS_SSL_VERIFY_NONE);
    } else if (self->crt_bundle_attach != NULL) {
        mbedtls_ssl_conf_authmode(&o->conf, MBEDTLS_SSL_VERIFY_REQUIRED);
        self->crt_bundle_attach(&o->conf);
    } else if (self->cacert_buf && self->cacert_bytes) {
        ret = mbedtls_x509_crt_parse(&o->cacert, self->cacert_buf, self->cacert_bytes);
        if (ret != 0) {
            goto cleanup;
        }
        mbedtls_ssl_conf_authmode(&o->conf, MBEDTLS_SSL_VERIFY_REQUIRED);
        mbedtls_ssl_conf_ca_chain(&o->conf, &o->cacert, NULL);

    } else {
        mbedtls_ssl_conf_authmode(&o->conf, MBEDTLS_SSL_VERIFY_NONE);
    }

cleanup:
    return ret;
}
```
